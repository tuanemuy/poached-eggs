## config/west.yml
```yaml
manifest:
  defaults:
    revision: v0.2.1
  remotes:
    - name: zmkfirmware
      url-base: https://github.com/zmkfirmware
  projects:
    - name: zmk
      remote: zmkfirmware
      import: app/west.yml
    - name: poached_eggs
      url: https://github.com/omwegg/poached-egg-shield-module
      revision: main
  self:
    path: config
```
